## Documentation/devicetree/bindings/clock/qcom,clk-gp-mnd.yaml
```yaml
# SPDX-License-Identifier: (GPL-2.0-only OR BSD-2-Clause)
%YAML 1.2
---
$id: http://devicetree.org/schemas/clock/qcom,clk-gp-mnd.yaml#
$schema: http://devicetree.org/meta-schemas/core.yaml#

title: Qualcomm Peripheral Web's PDM GP_MN Clock Divider

maintainers:
  - Taniya Das <taniya.das@oss.qualcomm.com>

description: |
  The Peripheral Web's PDM GP_MN clock divider receives an input clock
  (TCXO4) with frequency Fin and generates an output clock with
  frequency Fout = Fin * (M / N) and a duty cycle controlled by D
  and routed over a gpio pin.

  The divider is configured using three registers:

  - GP_MN_CLK_MDIV: holds the M value.
  - GP_MN_CLK_NDIV: holds the ones complement of (N - M).
  - GP_MN_CLK_DUTY: holds the D value.

  For every N input clock cycles the GP_MN produces M output clock
  cycles. D is the number of native clock cycles in which the GP_MN
  output is low, counted over 2^13 native clock cycles.

  Hardware constraints:

    M <= 511
    N <= 8191
    N > 2 * M
    M < D < (N - M)
    M and N must be coprime (no common divisor)

properties:
  compatible:
    oneOf:
      - const: qcom,sc7280-gp-mnd
      - items:
          - enum:
              - qcom,sa8775p-gp-mnd
              - qcom,qcs8300-gp-mnd
              - qcom,qcs615-gp-mnd
          - const: qcom,sc7280-gp-mnd

  reg:
    maxItems: 1

  clocks:
    items:
      - description: PDM XO4 source clock
      - description: PDM AHB bus clock for register access

  clock-names:
    items:
      - const: pdm_clk
      - const: ahb_clk

  '#clock-cells':
    const: 0

  assigned-clocks:
    maxItems: 1
    description: Parent clock phandle used to set the input frequency.

  assigned-clock-rates:
    maxItems: 1
    description: |
      Rate for the parent clock in Hz.
      Supported rates: 19200000, 9600000, 6400000, 4800000.

required:
  - compatible
  - reg
  - clocks
  - clock-names
  - '#clock-cells'
  - assigned-clocks
  - assigned-clock-rates

additionalProperties: false

examples:
  - |
    #include <dt-bindings/clock/qcom,gcc-sc7280.h>
    gp_mn: clock-controller@88d3000 {
        compatible = "qcom,sc7280-gp-mnd";
        reg = <0x88d3000 0x1000>;
        clocks = <&gcc GCC_PDM_XO4_CLK>,
                 <&gcc GCC_PDM_AHB_CLK>;
        clock-names = "pdm_clk", "ahb_clk";
        pinctrl-0 = <&gp_mn_pin_active>;
        pinctrl-names = "default";
        assigned-clocks = <&gcc GCC_PDM_XO4_CLK>;
        assigned-clock-rates = <4800000>;
        #clock-cells = <0>;
    };
```

## Documentation/devicetree/bindings/display/bridge/parade,ps195.yaml
```yaml
# SPDX-License-Identifier: (GPL-2.0-only OR BSD-2-Clause)
%YAML 1.2
---
$id: http://devicetree.org/schemas/display/bridge/parade,ps195.yaml#
$schema: http://devicetree.org/meta-schemas/core.yaml#

title: Parade PS195 DisplayPort to HDMI protocol converter

maintainers:
  - Mahadevan P <mahadevan.p@oss.qualcomm.com>

description:
  The PS195 converts DisplayPort input to HDMI output. Firmware loaded from
  an external SPI flash handles link training, EDID access and hotplug
  detection. This binding describes operation without host control of
  the device registers. The optional I2C control port is not required for
  display operation. Reset may be controlled by a GPIO or released by a
  board resistor-capacitor network.

properties:
  compatible:
    const: parade,ps195

  vdd09-supply:
    description: 0.95 V core and analog supply.

  vdd12-supply:
    description: 1.2 V I/O supply.

  vdd33-supply:
    description: 3.3 V supply.

  reset-gpios:
    maxItems: 1
    description: GPIO connected to the active-low RESETB input.

  ports:
    $ref: /schemas/graph.yaml#/properties/ports
    unevaluatedProperties: false

    properties:
      port@0:
        $ref: /schemas/graph.yaml#/properties/port
        unevaluatedProperties: false
        description: DisplayPort input.

      port@1:
        $ref: /schemas/graph.yaml#/properties/port
        unevaluatedProperties: false
        description: HDMI output.

    required:
      - port@0
      - port@1

required:
  - compatible
  - vdd09-supply
  - vdd12-supply
  - vdd33-supply
  - ports

additionalProperties: false

examples:
  - |
    #include <dt-bindings/gpio/gpio.h>

    hdmi-bridge {
        compatible = "parade,ps195";

        vdd09-supply = <&vreg_hdmi_0p95>;
        vdd12-supply = <&vreg_hdmi_1p2>;
        vdd33-supply = <&vreg_hdmi_3p3>;

        reset-gpios = <&gpio 0 GPIO_ACTIVE_LOW>;

        ports {
            #address-cells = <1>;
            #size-cells = <0>;

            port@0 {
                reg = <0>;

                bridge_in: endpoint {
                    remote-endpoint = <&dp_out>;
                };
            };

            port@1 {
                reg = <1>;

                bridge_out: endpoint {
                    remote-endpoint = <&hdmi_connector_in>;
                };
            };
        };
    };
```

## Documentation/devicetree/bindings/leds/backlight/gpio-backlight.yaml
```yaml
# SPDX-License-Identifier: GPL-2.0-only
%YAML 1.2
---
$id: http://devicetree.org/schemas/leds/backlight/gpio-backlight.yaml#
$schema: http://devicetree.org/meta-schemas/core.yaml#

title: gpio-backlight

maintainers:
  - Lee Jones <lee@kernel.org>
  - Daniel Thompson <daniel.thompson@linaro.org>
  - Jingoo Han <jingoohan1@gmail.com>

properties:
  compatible:
    const: gpio-backlight

  gpios:
    description: |
      The gpio that is used for enabling/disabling the backlight.
      Multiple GPIOs can be specified for panels that require several
      enable signals. All GPIOs are controlled together.
    type: array
    minItems: 1
    items:
      type: array
      minItems: 3
      maxItems: 3
      items:
        type: integer

  default-on:
    description: enable the backlight at boot.
    type: boolean

required:
  - compatible
  - gpios

additionalProperties: false

examples:
  - |
    #include <dt-bindings/gpio/gpio.h>
    backlight {
        compatible = "gpio-backlight";
        gpios = <&gpio3 4 GPIO_ACTIVE_HIGH>;
        default-on;
    };

  - |
    #include <dt-bindings/gpio/gpio.h>
    backlight {
      compatible = "gpio-backlight";
      gpios = <&gpio3 4 GPIO_ACTIVE_HIGH>,
              <&gpio3 5 GPIO_ACTIVE_HIGH>,
              <&gpio3 6 GPIO_ACTIVE_HIGH>;
      default-on;
    };

...
```
