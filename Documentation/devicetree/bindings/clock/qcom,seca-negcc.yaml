## Documentation/devicetree/bindings/interconnect/qcom,seca-rpmh.yaml
```yaml
# SPDX-License-Identifier: (GPL-2.0-only OR BSD-2-Clause)
%YAML 1.2
---
$id: http://devicetree.org/schemas/interconnect/qcom,seca-rpmh.yaml#
$schema: http://devicetree.org/meta-schemas/core.yaml#

title: Qualcomm RPMh Network-On-Chip Interconnect on Seca SoCs

maintainers:
  - Bartosz Golaszewski <brgl@kernel.org>

description: |
  RPMh interconnect providers support system bandwidth requirements through
  RPMh hardware accelerators known as Bus Clock Manager (BCM). The provider is
  able to communicate with the BCM through the Resource State Coordinator (RSC)
  associated with each execution environment. Provider nodes must point to at
  least one RPMh device child node pertaining to their RSC and each provider
  can map to multiple RPMh resources.

  See also: include/dt-bindings/interconnect/qcom,seca-rpmh.h

properties:
  compatible:
    enum:
      - qcom,seca-aggre1-noc
      - qcom,seca-aggre1-noc-tile
      - qcom,seca-aggre2-noc
      - qcom,seca-aggre2-noc-tile
      - qcom,seca-clk-virt
      - qcom,seca-cnoc-cfg
      - qcom,seca-cnoc-main
      - qcom,seca-hpass-ag-noc
      - qcom,seca-hscnoc
      - qcom,seca-mc-virt
      - qcom,seca-mmss-noc-hf
      - qcom,seca-mmss-noc-sf
      - qcom,seca-nsp-data-noc-0
      - qcom,seca-nsp-data-noc-1
      - qcom,seca-pcie-cfg
      - qcom,seca-pcie-data-inbound
      - qcom,seca-pcie-data-outbound
      - qcom,seca-system-noc

  reg:
    maxItems: 1

  clocks:
    minItems: 1
    maxItems: 3

required:
  - compatible

allOf:
  - $ref: qcom,rpmh-common.yaml#
  - if:
      properties:
        compatible:
          contains:
            enum:
              - qcom,seca-clk-virt
              - qcom,seca-mc-virt
    then:
      properties:
        reg: false
    else:
      required:
        - reg

  - if:
      properties:
        compatible:
          contains:
            enum:
              - qcom,seca-aggre1-noc
    then:
      properties:
        clocks:
          items:
            - description: aggre USB2 AXI clock
            - description: aggre USB3 PRIM AXI clock
            - description: aggre USB3 SEC AXI clock

  - if:
      properties:
        compatible:
          contains:
            enum:
              - qcom,seca-aggre1-noc-tile
    then:
      properties:
        clocks:
          items:
            - description: aggre UFS 0 PHY AXI clock
            - description: aggre UFS 1 PHY AXI clock

  - if:
      properties:
        compatible:
          contains:
            enum:
              - qcom,seca-aggre2-noc
    then:
      properties:
        clocks:
          items:
            - description: RPMH CC IPA clock

  - if:
      properties:
        compatible:
          contains:
            enum:
              - qcom,seca-aggre1-noc
              - qcom,seca-aggre1-noc-tile
              - qcom,seca-aggre2-noc
    then:
      required:
        - clocks
    else:
      properties:
        clocks: false

unevaluatedProperties: false

examples:
  - |
    clk_virt: interconnect-clk-virt {
      compatible = "qcom,seca-clk-virt";
      #interconnect-cells = <2>;
      qcom,bcm-voters = <&apps_bcm_voter>;
    };

    aggre1_noc_tile: interconnect@1720000 {
      compatible = "qcom,seca-aggre1-noc-tile";
      reg = <0x01720000 0x23400>;
      #interconnect-cells = <2>;
      qcom,bcm-voters = <&apps_bcm_voter>;
      clocks = <&nw_gcc_aggre_noc_ufs_0_phy_axi_clk>,
               <&nw_gcc_aggre_noc_ufs_1_phy_axi_clk>;
    };
```

## Documentation/devicetree/bindings/nvmem/layouts/fixed-cell.yaml
```yaml
# SPDX-License-Identifier: (GPL-2.0-only OR BSD-2-Clause)
%YAML 1.2
---
$id: http://devicetree.org/schemas/nvmem/layouts/fixed-cell.yaml#
$schema: http://devicetree.org/meta-schemas/core.yaml#

title: Fixed offset & size NVMEM cell

maintainers:
  - Rafał Miłecki <rafal@milecki.pl>
  - Srinivas Kandagatla <srinivas.kandagatla@linaro.org>

properties:
  compatible:
    oneOf:
      - const: mac-base
        description: >
          Cell with base MAC address to be used for calculating extra relative
          addresses.
          It can be stored in a plain binary format (cell length 6) or as an
          ASCII text like "00:11:22:33:44:55" (cell length 17).

  reg:
    maxItems: 1

  bits:
    $ref: /schemas/types.yaml#/definitions/uint32-array
    items:
      - minimum: 0
        maximum: 31
        description:
          Offset in bit within the address range specified by reg.
      - minimum: 1
        description:
          Size in bit within the address range specified by reg.

  byte-mask:
    $ref: /schemas/types.yaml#/definitions/uint32
    minimum: 1
    description: >
      Bitmask selecting which physical bytes within the NVMEM device region
      contribute to this cell's output. Bit N set means physical byte N
      relative to the cell's base offset is included; selected bytes are
      packed into the output buffer in ascending byte order. Byte positions
      are relative to the cell's base offset and limited to a 32-byte window.
      The highest set bit must not reference a byte beyond the device size.
      The number of set bits must not exceed the cell's logical size given by
      reg. Cannot be used together with bits. Cells using byte-mask are
      read-only; write operations are not supported.

allOf:
  - if:
      properties:
        compatible:
          contains:
            const: mac-base
      required: [ compatible ]
    then:
      properties:
        "#nvmem-cell-cells":
          description: The first argument is a MAC address offset.
          const: 1
      required:
        - "#nvmem-cell-cells"
  - if:
      required: [ byte-mask ]
    then:
      properties:
        bits: false
      description:
        byte-mask and bits are mutually exclusive.

required:
  - reg

additionalProperties: true
```
