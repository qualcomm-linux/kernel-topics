## Documentation/devicetree/bindings/clock/qcom,seca-negcc.yaml
```yaml
# SPDX-License-Identifier: (GPL-2.0-only OR BSD-2-Clause)
%YAML 1.2
---
$id: http://devicetree.org/schemas/clock/qcom,seca-negcc.yaml#
$schema: http://devicetree.org/meta-schemas/core.yaml#

title: North East Global Clock & Reset Controller on Qualcomm Seca SoC

maintainers:
  - Bartosz Golaszewski <brgl@kernel.org>

description: |
  Qualcomm North East Global Clock Control (NE) module provides the clocks,
  resets and power domains on Seca SoC.

  See also: include/dt-bindings/clock/qcom,seca-negcc.h

properties:
  compatible:
    const: qcom,seca-negcc

  clocks:
    items:
      - description: Board XO source
      - description: Sleep clock source
      - description: USB3 Phy sec wrapper pipe clock source
      - description: USB3 Phy wrapper pipe clock source

  power-domains:
    items:
      - description: CX power domain

required:
  - compatible
  - clocks
  - power-domains
  - '#power-domain-cells'

allOf:
  - $ref: qcom,gcc.yaml#

unevaluatedProperties: false

examples:
  - |
    #include <dt-bindings/clock/qcom,rpmh.h>
    #include <dt-bindings/power/qcom,rpmhpd.h>
    clock-controller@8900000 {
      compatible = "qcom,seca-negcc";
      reg = <0x08900000 0xf4200>;
      clocks = <&rpmhcc RPMH_CXO_CLK>,
               <&sleep_clk>,
               <&usb3_phy_sec_pipe_clk>,
               <&usb3_phy_pipe_clk>;
      power-domains = <&rpmhpd RPMHPD_CX>;
      #clock-cells = <1>;
      #reset-cells = <1>;
      #power-domain-cells = <1>;
    };

...
```

## Documentation/devicetree/bindings/clock/qcom,seca-nwgcc.yaml
```yaml
# SPDX-License-Identifier: (GPL-2.0-only OR BSD-2-Clause)
%YAML 1.2
---
$id: http://devicetree.org/schemas/clock/qcom,seca-nwgcc.yaml#
$schema: http://devicetree.org/meta-schemas/core.yaml#

title: North West Global Clock & Reset Controller on Qualcomm Seca SoC

maintainers:
  - Bartosz Golaszewski <brgl@kernel.org>

description: |
  Qualcomm North West Global Clock Control (NW) module provides the clocks,
  resets and power domains on Seca SoC.

  See also: include/dt-bindings/clock/qcom,seca-nwgcc.h

properties:
  compatible:
    const: qcom,seca-nwgcc

  clocks:
    items:
      - description: Board XO source
      - description: Sleep clock source
      - description: UFS 0 Phy Rx symbol 0 clock source
      - description: UFS 0 Phy Rx symbol 1 clock source
      - description: UFS 0 Phy Tx symbol 0 clock source
      - description: UFS 1 Phy Rx symbol 0 clock source
      - description: UFS 1 Phy Rx symbol 1 clock source
      - description: UFS 1 Phy Tx symbol 0 clock source

  power-domains:
    items:
      - description: CX power domain

required:
  - compatible
  - clocks
  - power-domains
  - '#power-domain-cells'

allOf:
  - $ref: qcom,gcc.yaml#

unevaluatedProperties: false

examples:
  - |
    #include <dt-bindings/clock/qcom,rpmh.h>
    #include <dt-bindings/power/qcom,rpmhpd.h>
    clock-controller@8b00000 {
      compatible = "qcom,seca-nwgcc";
      reg = <0x08b00000 0xf4200>;
      clocks = <&rpmhcc RPMH_CXO_CLK>,
               <&sleep_clk>,
               <&ufs_0_phy 0>,
               <&ufs_0_phy 1>,
               <&ufs_0_phy 2>,
               <&ufs_1_phy 0>,
               <&ufs_1_phy 1>,
               <&ufs_1_phy 2>;
      power-domains = <&rpmhpd RPMHPD_CX>;
      #clock-cells = <1>;
      #reset-cells = <1>;
      #power-domain-cells = <1>;
    };

...
```

## Documentation/devicetree/bindings/clock/qcom,seca-tcsr.yaml
```yaml
# SPDX-License-Identifier: (GPL-2.0-only OR BSD-2-Clause)
%YAML 1.2
---
$id: http://devicetree.org/schemas/clock/qcom,seca-tcsr.yaml#
$schema: http://devicetree.org/meta-schemas/core.yaml#

title: Top Control and Status Register Clock Controller on Qualcomm Seca SoC

maintainers:
  - Bartosz Golaszewski <brgl@kernel.org>

description: |
  Qualcomm TCSR clock control module provides the clocks, resets and power
  domains on the Seca SoC.

  See also:
  - include/dt-bindings/clock/qcom,seca-tcsrcc.h

properties:
  compatible:
    const: qcom,seca-tcsr

  clocks:
    items:
      - description: TCXO pad clock

  reg:
    maxItems: 1

  '#clock-cells':
    const: 1

  vdda-qref-1p2-supply: true
  vdda-qref0-0p9-supply: true
  vdda-qref1-0p9-supply: true
  vdda-qref2-0p9-supply: true

required:
  - compatible
  - reg
  - clocks
  - '#clock-cells'
  - vdda-qref-1p2-supply
  - vdda-qref0-0p9-supply
  - vdda-qref1-0p9-supply
  - vdda-qref2-0p9-supply

additionalProperties: false

examples:
  - |
    #include <dt-bindings/clock/qcom,rpmh.h>

    clock-controller@f1d7000 {
      compatible = "qcom,seca-tcsr";
      reg = <0xf1d7000 0xf00c>;
      clocks = <&rpmhcc RPMH_CXO_CLK>;
      #clock-cells = <1>;
      vdda-qref-1p2-supply = <&vreg_px11>;
      vdda-qref0-0p9-supply = <&vreg_l1h>;
      vdda-qref1-0p9-supply = <&vreg_l1h>;
      vdda-qref2-0p9-supply = <&vreg_l1h>;
    };

...
```
