## Documentation/devicetree/bindings/media/qcom,kaanapali-camss.yaml
```yaml
# SPDX-License-Identifier: (GPL-2.0 OR BSD-2-Clause)
%YAML 1.2
---
$id: http://devicetree.org/schemas/media/qcom,kaanapali-camss.yaml#
$schema: http://devicetree.org/meta-schemas/core.yaml#

title: Qualcomm Kaanapali Camera Subsystem (CAMSS)

maintainers:
  - Hangxiang Ma <hangxiang.ma@oss.qualcomm.com>

description:
  Kaanapali camera subsystem includes submodules such as CSIPHY (CSI Physical Layer)
  and CSID (CSI Decoder), which comply with the MIPI CSI2 protocol.

  The subsystem also integrates a set of real-time image processing engines and
  their associated configuration modules, as well as non-real-time engines.

  Additionally, it encompasses a test pattern generator (TPG) submodule.

properties:
  compatible:
    const: qcom,kaanapali-camss

  reg:
    items:
      - description: Registers for CSID 0
      - description: Registers for CSID 1
      - description: Registers for CSID 2
      - description: Registers for CSID Lite 0
      - description: Registers for CSID Lite 1
      - description: Registers for CSIPHY 0
      - description: Registers for CSIPHY 1
      - description: Registers for CSIPHY 2
      - description: Registers for CSIPHY 3
      - description: Registers for CSIPHY 4
      - description: Registers for CSIPHY 5
      - description: Registers for VFE (Video Front End) 0
      - description: Registers for VFE 1
      - description: Registers for VFE 2
      - description: Registers for VFE Lite 0
      - description: Registers for VFE Lite 1
      - description: Registers for ICP (Imaging Control Processor) 0
      - description: Registers for ICP 0 SYS
      - description: Registers for ICP 1
      - description: Registers for ICP 1 SYS
      - description: Registers for IPE (Image Processing Engine)
      - description: Registers for JPEG DMA & Downscaler
      - description: Registers for JPEG Encoder
      - description: Registers for OFE (Offline Front End)
      - description: Registers for RT CDM (Camera Data Mover) 0
      - description: Registers for RT CDM 1
      - description: Registers for RT CDM 2
      - description: Registers for RT CDM 3
      - description: Registers for RT CDM 4
      - description: Registers for TPG 0
      - description: Registers for TPG 1
      - description: Registers for TPG 2

  reg-names:
    items:
      - const: csid0
      - const: csid1
      - const: csid2
      - const: csid_lite0
      - const: csid_lite1
      - const: csiphy0
      - const: csiphy1
      - const: csiphy2
      - const: csiphy3
      - const: csiphy4
      - const: csiphy5
      - const: vfe0
      - const: vfe1
      - const: vfe2
      - const: vfe_lite0
      - const: vfe_lite1
      - const: icp0
      - const: icp0_sys
      - const: icp1
      - const: icp1_sys
      - const: ipe
      - const: jpeg_dma
      - const: jpeg_enc
      - const: ofe
      - const: rt_cdm0
      - const: rt_cdm1
      - const: rt_cdm2
      - const: rt_cdm3
      - const: rt_cdm4
      - const: tpg0
      - const: tpg1
      - const: tpg2

  clocks:
    maxItems: 60

  clock-names:
    items:
      - const: camnoc_nrt_axi
      - const: camnoc_rt_axi
      - const: camnoc_rt_vfe0
      - const: camnoc_rt_vfe1
      - const: camnoc_rt_vfe2
      - const: camnoc_rt_vfe_lite
      - const: cpas_ahb
      - const: cpas_fast_ahb
      - const: csid
      - const: csid_csiphy_rx
      - const: csiphy0
      - const: csiphy0_timer
      - const: csiphy1
      - const: csiphy1_timer
      - const: csiphy2
      - const: csiphy2_timer
      - const: csiphy3
      - const: csiphy3_timer
      - const: csiphy4
      - const: csiphy4_timer
      - const: csiphy5
      - const: csiphy5_timer
      - const: gcc_axi_hf
      - const: vfe0
      - const: vfe0_fast_ahb
      - const: vfe1
      - const: vfe1_fast_ahb
      - const: vfe2
      - const: vfe2_fast_ahb
      - const: vfe_lite
      - const: vfe_lite_ahb
      - const: vfe_lite_cphy_rx
      - const: vfe_lite_csid
      - const: qdss_debug_xo
      - const: camnoc_ipe_nps
      - const: camnoc_ofe
      - const: gcc_axi_sf
      - const: icp0
      - const: icp0_ahb
      - const: icp1
      - const: icp1_ahb
      - const: ipe_nps
      - const: ipe_nps_ahb
      - const: ipe_nps_fast_ahb
      - const: ipe_pps
      - const: ipe_pps_fast_ahb
      - const: jpeg
      - const: ofe_ahb
      - const: ofe_anchor
      - const: ofe_anchor_fast_ahb
      - const: ofe_hdr
      - const: ofe_hdr_fast_ahb
      - const: ofe_main
      - const: ofe_main_fast_ahb
      - const: vfe0_bayer
      - const: vfe0_bayer_fast_ahb
      - const: vfe1_bayer
      - const: vfe1_bayer_fast_ahb
      - const: vfe2_bayer
      - const: vfe2_bayer_fast_ahb

  interrupts:
    maxItems: 30

  interrupt-names:
    items:
      - const: csid0
      - const: csid1
      - const: csid2
      - const: csid_lite0
      - const: csid_lite1
      - const: csiphy0
      - const: csiphy1
      - const: csiphy2
      - const: csiphy3
      - const: csiphy4
      - const: csiphy5
      - const: vfe0
      - const: vfe1
      - const: vfe2
      - const: vfe_lite0
      - const: vfe_lite1
      - const: camnoc_nrt
      - const: camnoc_rt
      - const: icp0
      - const: icp1
      - const: jpeg_dma
      - const: jpeg_enc
      - const: rt_cdm0
      - const: rt_cdm1
      - const: rt_cdm2
      - const: rt_cdm3
      - const: rt_cdm4
      - const: tpg0
      - const: tpg1
      - const: tpg2

  interconnects:
    maxItems: 4

  interconnect-names:
    items:
      - const: cam_ahb
      - const: cam_hf_mnoc
      - const: cam_sf_icp_mnoc
      - const: cam_sf_mnoc

  iommus:
    items:
      - description: VFE non-protected stream
      - description: ICP0 shared stream
      - description: ICP1 shared stream
      - description: IPE CDM non-protected stream
      - description: IPE non-protected stream
      - description: JPEG non-protected stream
      - description: OFE CDM non-protected stream
      - description: OFE non-protected stream
      - description: VFE / VFE Lite CDM non-protected stream

  power-domains:
    items:
      - description:
          IFE0 GDSC - Global Distributed Switch Controller for IFE0.
      - description:
          IFE1 GDSC - Global Distributed Switch Controller for IFE1.
      - description:
          IFE2 GDSC - Global Distributed Switch Controller for IFE2.
      - description:
          Titan GDSC - Global Distributed Switch Controller for the entire camss.
      - description:
          IPE GDSC - Global Distributed Switch Controller for IPE.
      - description:
          OFE GDSC - Block Global Distributed Switch Controller for OFE.

  power-domain-names:
    items:
      - const: ife0
      - const: ife1
      - const: ife2
      - const: top
      - const: ipe
      - const: ofe

  vdd-csiphy0-0p8-supply:
    description:
      Phandle to a 0.8V regulator supply to CSIPHY0 core block.

  vdd-csiphy0-1p2-supply:
    description:
      Phandle to a 1.2V regulator supply to CSIPHY0 pll block.

  vdd-csiphy1-0p8-supply:
    description:
      Phandle to a 0.8V regulator supply to CSIPHY1 core block.

  vdd-csiphy1-1p2-supply:
    description:
      Phandle to a 1.2V regulator supply to CSIPHY1 pll block.

  vdd-csiphy2-0p8-supply:
    description:
      Phandle to a 0.8V regulator supply to CSIPHY2 core block.

  vdd-csiphy2-1p2-supply:
    description:
      Phandle to a 1.2V regulator supply to CSIPHY2 pll block.

  vdd-csiphy3-0p8-supply:
    description:
      Phandle to a 0.8V regulator supply to CSIPHY3 core block.

  vdd-csiphy3-1p2-supply:
    description:
      Phandle to a 1.2V regulator supply to CSIPHY3 pll block.

  vdd-csiphy4-0p8-supply:
    description:
      Phandle to a 0.8V regulator supply to CSIPHY4 core block.

  vdd-csiphy4-1p2-supply:
    description:
      Phandle to a 1.2V regulator supply to CSIPHY4 pll block.

  vdd-csiphy5-0p8-supply:
    description:
      Phandle to a 0.8V regulator supply to CSIPHY5 core block.

  vdd-csiphy5-1p2-supply:
    description:
      Phandle to a 1.2V regulator supply to CSIPHY5 pll block.

  ports:
    $ref: /schemas/graph.yaml#/properties/ports

    description:
      CSI input ports.

patternProperties:
  "^port@[0-5]$":
    $ref: /schemas/graph.yaml#/$defs/port-base
    unevaluatedProperties: false
    description:
      Input ports for receiving CSI data on CSIPHY 0-5.

    properties:
      endpoint:
        $ref: video-interfaces.yaml#
        unevaluatedProperties: false

        properties:
          data-lanes:
            minItems: 1
            maxItems: 4

        required:
          - data-lanes

required:
  - compatible
  - reg
  - reg-names
  - clocks
  - clock-names
  - interrupts
  - interrupt-names
  - interconnects
  - interconnect-names
  - iommus
  - power-domains
  - power-domain-names

additionalProperties: false

examples:
  - |
    #include <dt-bindings/interconnect/qcom,icc.h>
    #include <dt-bindings/interrupt-controller/arm-gic.h>
    #include <dt-bindings/power/qcom,rpmhpd.h>

    soc {
        #address-cells = <2>;
        #size-cells = <2>;

        isp@9253000 {
            compatible = "qcom,kaanapali-camss";

            reg = <0x0 0x09253000 0x0 0x5e80>,
                  <0x0 0x09263000 0x0 0x5e80>,
                  <0x0 0x09273000 0x0 0x5e80>,
                  <0x0 0x092d3000 0x0 0x3880>,
                  <0x0 0x092e7000 0x0 0x3880>,
                  <0x0 0x09523000 0x0 0x2000>,
                  <0x0 0x09525000 0x0 0x2000>,
                  <0x0 0x09527000 0x0 0x2000>,
                  <0x0 0x09529000 0x0 0x2000>,
                  <0x0 0x0952b000 0x0 0x2000>,
                  <0x0 0x0952d000 0x0 0x2000>,
                  <0x0 0x09151000 0x0 0x20000>,
                  <0x0 0x09171000 0x0 0x20000>,
                  <0x0 0x09191000 0x0 0x20000>,
                  <0x0 0x092dc000 0x0 0x1300>,
                  <0x0 0x092f0000 0x0 0x1300>,
                  <0x0 0x0900e000 0x0 0x1000>,
                  <0x0 0x0900d000 0x0 0x1000>,
                  <0x0 0x0902e000 0x0 0x1000>,
                  <0x0 0x0902d000 0x0 0x1000>,
                  <0x0 0x090d7000 0x0 0x20000>,
                  <0x0 0x0904e000 0x0 0x1000>,
                  <0x0 0x0904d000 0x0 0x1000>,
                  <0x0 0x09057000 0x0 0x40000>,
                  <0x0 0x09147000 0x0 0x580>,
                  <0x0 0x09148000 0x0 0x580>,
                  <0x0 0x09149000 0x0 0x580>,
                  <0x0 0x0914a000 0x0 0x580>,
                  <0x0 0x0914b000 0x0 0x580>,
                  <0x0 0x093fd000 0x0 0x400>,
                  <0x0 0x093fe000 0x0 0x400>,
                  <0x0 0x093ff000 0x0 0x400>;
            reg-names = "csid0",
                        "csid1",
                        "csid2",
                        "csid_lite0",
                        "csid_lite1",
                        "csiphy0",
                        "csiphy1",
                        "csiphy2",
                        "csiphy3",
                        "csiphy4",
                        "csiphy5",
                        "vfe0",
                        "vfe1",
                        "vfe2",
                        "vfe_lite0",
                        "vfe_lite1",
                        "icp0",
                        "icp0_sys",
                        "icp1",
                        "icp1_sys",
                        "ipe",
                        "jpeg_dma",
                        "jpeg_enc",
                        "ofe",
                        "rt_cdm0",
                        "rt_cdm1",
                        "rt_cdm2",
                        "rt_cdm3",
                        "rt_cdm4",
                        "tpg0",
                        "tpg1",
                        "tpg2";

            clocks = <&camcc_cam_cc_camnoc_nrt_axi_clk>,
                     <&camcc_cam_cc_camnoc_rt_axi_clk>,
                     <&camcc_cam_cc_camnoc_rt_vfe_0_main_clk>,
                     <&camcc_cam_cc_camnoc_rt_vfe_1_main_clk>,
                     <&camcc_cam_cc_camnoc_rt_vfe_2_main_clk>,
                     <&camcc_cam_cc_camnoc_rt_vfe_lite_clk>,
                     <&camcc_cam_cc_cam_top_ahb_clk>,
                     <&camcc_cam_cc_cam_top_fast_ahb_clk>,
                     <&camcc_cam_cc_csid_clk>,
                     <&camcc_cam_cc_csid_csiphy_rx_clk>,
                     <&camcc_cam_cc_csiphy0_clk>,
                     <&camcc_cam_cc_csi0phytimer_clk>,
                     <&camcc_cam_cc_csiphy1_clk>,
                     <&camcc_cam_cc_csi1phytimer_clk>,
                     <&camcc_cam_cc_csiphy2_clk>,
                     <&camcc_cam_cc_csi2phytimer_clk>,
                     <&camcc_cam_cc_csiphy3_clk>,
                     <&camcc_cam_cc_csi3phytimer_clk>,
                     <&camcc_cam_cc_csiphy4_clk>,
                     <&camcc_cam_cc_csi4phytimer_clk>,
                     <&camcc_cam_cc_csiphy5_clk>,
                     <&camcc_cam_cc_csi5phytimer_clk>,
                     <&gcc_gcc_camera_hf_axi_clk>,
                     <&camcc_cam_cc_vfe_0_main_clk>,
                     <&camcc_cam_cc_vfe_0_main_fast_ahb_clk>,
                     <&camcc_cam_cc_vfe_1_main_clk>,
                     <&camcc_cam_cc_vfe_1_main_fast_ahb_clk>,
                     <&camcc_cam_cc_vfe_2_main_clk>,
                     <&camcc_cam_cc_vfe_2_main_fast_ahb_clk>,
                     <&camcc_cam_cc_vfe_lite_clk>,
                     <&camcc_cam_cc_vfe_lite_ahb_clk>,
                     <&camcc_cam_cc_vfe_lite_cphy_rx_clk>,
                     <&camcc_cam_cc_vfe_lite_csid_clk>,
                     <&camcc_cam_cc_qdss_debug_xo_clk>,
                     <&camcc_cam_cc_camnoc_nrt_ipe_nps_clk>,
                     <&camcc_cam_cc_camnoc_nrt_ofe_main_clk>,
                     <&gcc_gcc_camera_sf_axi_clk>,
                     <&camcc_cam_cc_icp_0_clk>,
                     <&camcc_cam_cc_icp_0_ahb_clk>,
                     <&camcc_cam_cc_icp_1_clk>,
                     <&camcc_cam_cc_icp_1_ahb_clk>,
                     <&camcc_cam_cc_ipe_nps_clk>,
                     <&camcc_cam_cc_ipe_nps_ahb_clk>,
                     <&camcc_cam_cc_ipe_nps_fast_ahb_clk>,
                     <&camcc_cam_cc_ipe_pps_clk>,
                     <&camcc_cam_cc_ipe_pps_fast_ahb_clk>,
                     <&camcc_cam_cc_jpeg_clk>,
                     <&camcc_cam_cc_ofe_ahb_clk>,
                     <&camcc_cam_cc_ofe_anchor_clk>,
                     <&camcc_cam_cc_ofe_anchor_fast_ahb_clk>,
                     <&camcc_cam_cc_ofe_hdr_clk>,
                     <&camcc_cam_cc_ofe_hdr_fast_ahb_clk>,
                     <&camcc_cam_cc_ofe_main_clk>,
                     <&camcc_cam_cc_ofe_main_fast_ahb_clk>,
                     <&camcc_cam_cc_vfe_0_bayer_clk>,
                     <&camcc_cam_cc_vfe_0_bayer_fast_ahb_clk>,
                     <&camcc_cam_cc_vfe_1_bayer_clk>,
                     <&camcc_cam_cc_vfe_1_bayer_fast_ahb_clk>,
                     <&camcc_cam_cc_vfe_2_bayer_clk>,
                     <&camcc_cam_cc_vfe_2_bayer_fast_ahb_clk>;
            clock-names = "camnoc_nrt_axi",
                          "camnoc_rt_axi",
                          "camnoc_rt_vfe0",
                          "camnoc_rt_vfe1",
                          "camnoc_rt_vfe2",
                          "camnoc_rt_vfe_lite",
                          "cpas_ahb",
                          "cpas_fast_ahb",
                          "csid",
                          "csid_csiphy_rx",
                          "csiphy0",
                          "csiphy0_timer",
                          "csiphy1",
                          "csiphy1_timer",
                          "csiphy2",
                          "csiphy2_timer",
                          "csiphy3",
                          "csiphy3_timer",
                          "csiphy4",
                          "csiphy4_timer",
                          "csiphy5",
                          "csiphy5_timer",
                          "gcc_axi_hf",
                          "vfe0",
                          "vfe0_fast_ahb",
                          "vfe1",
                          "vfe1_fast_ahb",
                          "vfe2",
                          "vfe2_fast_ahb",
                          "vfe_lite",
                          "vfe_lite_ahb",
                          "vfe_lite_cphy_rx",
                          "vfe_lite_csid",
                          "qdss_debug_xo",
                          "camnoc_ipe_nps",
                          "camnoc_ofe",
                          "gcc_axi_sf",
                          "icp0",
                          "icp0_ahb",
                          "icp1",
                          "icp1_ahb",
                          "ipe_nps",
                          "ipe_nps_ahb",
                          "ipe_nps_fast_ahb",
                          "ipe_pps",
                          "ipe_pps_fast_ahb",
                          "jpeg",
                          "ofe_ahb",
                          "ofe_anchor",
                          "ofe_anchor_fast_ahb",
                          "ofe_hdr",
                          "ofe_hdr_fast_ahb",
                          "ofe_main",
                          "ofe_main_fast_ahb",
                          "vfe0_bayer",
                          "vfe0_bayer_fast_ahb",
                          "vfe1_bayer",
                          "vfe1_bayer_fast_ahb",
                          "vfe2_bayer",
                          "vfe2_bayer_fast_ahb";

            interrupts = <GIC_SPI 601 IRQ_TYPE_EDGE_RISING>,
                         <GIC_SPI 603 IRQ_TYPE_EDGE_RISING>,
                         <GIC_SPI 431 IRQ_TYPE_EDGE_RISING>,
                         <GIC_SPI 605 IRQ_TYPE_EDGE_RISING>,
                         <GIC_SPI 376 IRQ_TYPE_EDGE_RISING>,
                         <GIC_SPI 477 IRQ_TYPE_EDGE_RISING>,
                         <GIC_SPI 478 IRQ_TYPE_EDGE_RISING>,
                         <GIC_SPI 479 IRQ_TYPE_EDGE_RISING>,
                         <GIC_SPI 448 IRQ_TYPE_EDGE_RISING>,
                         <GIC_SPI 122 IRQ_TYPE_EDGE_RISING>,
                         <GIC_SPI 89 IRQ_TYPE_EDGE_RISING>,
                         <GIC_SPI 433 IRQ_TYPE_EDGE_RISING>,
                         <GIC_SPI 436 IRQ_TYPE_EDGE_RISING>,
                         <GIC_SPI 457 IRQ_TYPE_EDGE_RISING>,
                         <GIC_SPI 606 IRQ_TYPE_EDGE_RISING>,
                         <GIC_SPI 377 IRQ_TYPE_EDGE_RISING>,
                         <GIC_SPI 271 IRQ_TYPE_EDGE_RISING>,
                         <GIC_SPI 277 IRQ_TYPE_EDGE_RISING>,
                         <GIC_SPI 463 IRQ_TYPE_EDGE_RISING>,
                         <GIC_SPI 657 IRQ_TYPE_EDGE_RISING>,
                         <GIC_SPI 372 IRQ_TYPE_EDGE_RISING>,
                         <GIC_SPI 475 IRQ_TYPE_EDGE_RISING>,
                         <GIC_SPI 456 IRQ_TYPE_EDGE_RISING>,
                         <GIC_SPI 664 IRQ_TYPE_EDGE_RISING>,
                         <GIC_SPI 702 IRQ_TYPE_EDGE_RISING>,
                         <GIC_SPI 348 IRQ_TYPE_EDGE_RISING>,
                         <GIC_SPI 349 IRQ_TYPE_EDGE_RISING>,
                         <GIC_SPI 413 IRQ_TYPE_EDGE_RISING>,
                         <GIC_SPI 416 IRQ_TYPE_EDGE_RISING>,
                         <GIC_SPI 417 IRQ_TYPE_EDGE_RISING>;
            interrupt-names = "csid0",
                              "csid1",
                              "csid2",
                              "csid_lite0",
                              "csid_lite1",
                              "csiphy0",
                              "csiphy1",
                              "csiphy2",
                              "csiphy3",
                              "csiphy4",
                              "csiphy5",
                              "vfe0",
                              "vfe1",
                              "vfe2",
                              "vfe_lite0",
                              "vfe_lite1",
                              "camnoc_nrt",
                              "camnoc_rt",
                              "icp0",
                              "icp1",
                              "jpeg_dma",
                              "jpeg_enc",
                              "rt_cdm0",
                              "rt_cdm1",
                              "rt_cdm2",
                              "rt_cdm3",
                              "rt_cdm4",
                              "tpg0",
                              "tpg1",
                              "tpg2";

            interconnects = <&gem_noc_master_appss_proc QCOM_ICC_TAG_ACTIVE_ONLY
                             &config_noc_slave_camera_cfg QCOM_ICC_TAG_ACTIVE_ONLY>,
                            <&mmss_noc_master_camnoc_hf QCOM_ICC_TAG_ALWAYS
                             &mc_virt_slave_ebi1 QCOM_ICC_TAG_ALWAYS>,
                            <&mmss_noc_master_camnoc_sf_icp QCOM_ICC_TAG_ALWAYS
                             &mc_virt_slave_ebi1 QCOM_ICC_TAG_ALWAYS>,
                            <&mmss_noc_master_camnoc_sf QCOM_ICC_TAG_ALWAYS
                             &mc_virt_slave_ebi1 QCOM_ICC_TAG_ALWAYS>;
            interconnect-names = "cam_ahb",
                                 "cam_hf_mnoc",
                                 "cam_sf_icp_mnoc",
                                 "cam_sf_mnoc";

            iommus = <&apps_smmu 0x1c00 0x00>,
                     <&apps_smmu 0x18c0 0x00>,
                     <&apps_smmu 0x1980 0x00>,
                     <&apps_smmu 0x1840 0x00>,
                     <&apps_smmu 0x1800 0x00>,
                     <&apps_smmu 0x18a0 0x00>,
                     <&apps_smmu 0x1880 0x00>,
                     <&apps_smmu 0x1820 0x00>,
                     <&apps_smmu 0x1860 0x00>;

            power-domains = <&camcc_cam_cc_ife_0_gdsc>,
                            <&camcc_cam_cc_ife_1_gdsc>,
                            <&camcc_cam_cc_ife_2_gdsc>,
                            <&camcc_cam_cc_titan_top_gdsc>,
                            <&camcc_cam_cc_ipe_gdsc>,
                            <&camcc_cam_cc_ofe_gdsc>;
            power-domain-names = "ife0",
                                 "ife1",
                                 "ife2",
                                 "top",
                                 "ipe",
                                 "ofe";

            vdd-csiphy0-0p8-supply = <&vreg_0p8_supply>;
            vdd-csiphy0-1p2-supply = <&vreg_1p2_supply>;

            ports {
                #address-cells = <1>;
                #size-cells = <0>;

                port@0 {
                    reg = <0>;

                    csiphy_ep0: endpoint {
                        data-lanes = <0 1>;
                        remote-endpoint = <&sensor_ep>;
                    };
                };
            };
        };
    };
```
