## Documentation/devicetree/bindings/arm/qcom,coresight-tgu.yaml
```yaml
# SPDX-License-Identifier: (GPL-2.0-only OR BSD-2-Clause)
%YAML 1.2
---
$id: http://devicetree.org/schemas/arm/qcom,coresight-tpdm.yaml#
$schema: http://devicetree.org/meta-schemas/core.yaml#

title: Trigger Generation Unit - TGU

description: |
  The Trigger Generation Unit (TGU) is a Data Engine which can be utilized
  to sense a plurality of signals and create a trigger into the CTI or
  generate interrupts to processors. The TGU is like the trigger circuit
  of a Logic Analyzer. Once setup and enabled, it will ‘observe’ sense
  inputs and based upon the activity of those inputs, even over clock
  cycles, may detect a preprogrammed state/sequence and then produce a
  trigger or interrupt.

  The primary use case of the TGU is to detect patterns or sequences on a
  given set of signals within some region of the SoC.

maintainers:
  - Mao Jinlong <quic_jinlmao@quicinc.com>

select:
  properties:
    compatible:
      contains:
        const: qcom,coresight-tgu
  required:
    - compatible

# Need a custom select here or 'arm,primecell' will match on lots of nodes
properties:
  compatible:
    items:
      - const: qcom,coresight-tgu
      - const: arm,primecell

  reg:
    minItems: 1
    maxItems: 2

  clocks:
    maxItems: 1

  clock-names:
    items:
      - const: apb_pclk

  tgu-steps:
    $ref: /schemas/types.yaml#/definitions/uint32
    description:
      This is a configuration parameter used to set the capture process of
      the Trigger Generation Unit (TGU).
    minItems: 1
    maxItems: 8

  tgu-conditions:
    $ref: /schemas/types.yaml#/definitions/uint32
    description:
      For every "sensed signal", there are some conditions, i.e. level detection
      and edge detection for input.
    minItems: 1
    maxItems: 4

  tgu-regs:
    $ref: /schemas/types.yaml#/definitions/uint32
    description:
      TGU registers are used to set the number of register for each step.
    minItems: 1
    maxItems: 32

  tgu-timer-counters:
    $ref: /schemas/types.yaml#/definitions/uint32
    description:
      This is a configuration parameter used to set the timer and counter steps.
    minItems: 1
    maxItems: 8

required:
  - compatible
  - reg
  - clocks
  - clock-names

additionalProperties: false

examples:
  # minimum TGU definition.
  - |
    tgu@10b0e000 {
      compatible = "arm,primecell", "qcom,coresight-tgu";
      arm,primecell-periphid = <0x000bb999>;
      reg = <0x10b0e000 0x1000>;
      reg-names = "tgu-base";

      clocks = <&aoss_qmp>;
      clock-names = "apb_pclk";

      tgu-steps = <3>;
      tgu-conditions = <4>;
      tgu-regs = <4>;
      tgu-timer-counters = <8>;
    };
...
```

## Documentation/devicetree/bindings/clock/qcom,kaanapali-gxclkctl.yaml
```yaml
# SPDX-License-Identifier: (GPL-2.0-only OR BSD-2-Clause)
%YAML 1.2
---
$id: http://devicetree.org/schemas/clock/qcom,kaanapali-gxclkctl.yaml#
$schema: http://devicetree.org/meta-schemas/core.yaml#

title: Qualcomm Graphics power domain Controller on Kaanapali

maintainers:
  - Taniya Das <taniya.das@oss.qualcomm.com>

description: |
  Qualcomm graphics power domain control module provides the power
  domains on Qualcomm SoCs. This module exposes the GDSC power domain
  which helps the recovery of Graphics subsystem.

  See also::
    include/dt-bindings/clock/qcom,kaanapali-gxclkctl.h

properties:
  compatible:
    enum:
      - qcom,kaanapali-gxclkctl

  power-domains:
    description:
      Power domains required for the clock controller to operate
    items:
      - description: GFX power domain
      - description: GMXC power domain
      - description: GPUCC(CX) power domain

  '#power-domain-cells':
    const: 1

  reg:
    maxItems: 1

required:
  - compatible
  - reg
  - power-domains
  - '#power-domain-cells'

unevaluatedProperties: false

examples:
  - |
    #include <dt-bindings/power/qcom,rpmhpd.h>
    soc {
        #address-cells = <2>;
        #size-cells = <2>;

        clock-controller@3d68024 {
            compatible = "qcom,kaanapali-gxclkctl";
            reg = <0 0x3d68024 0x0 0x8>;
            power-domains = <&rpmhpd RPMHPD_GFX>,
                            <&rpmhpd RPMHPD_GMXC>,
                            <&gpucc 0>;
            #power-domain-cells = <1>;
        };
    };
...
```

## Documentation/devicetree/bindings/clock/qcom,shikra-dispcc.yaml
```yaml
# SPDX-License-Identifier: (GPL-2.0-only OR BSD-2-Clause)
%YAML 1.2
---
$id: http://devicetree.org/schemas/clock/qcom,shikra-dispcc.yaml#
$schema: http://devicetree.org/meta-schemas/core.yaml#

title: Display Clock & Reset Controller for Qualcomm Shikra SoC

maintainers:
  - Imran Shaik <imran.shaik@oss.qualcomm.com>

description: |
  Display clock control module provides the clocks, resets and power
  domains on Qualcomm Shikra SoC platform.

  See also:
  - include/dt-bindings/clock/qcom,shikra-dispcc.h

properties:
  compatible:
    enum:
      - qcom,shikra-dispcc

  clocks:
    items:
      - description: Board XO source
      - description: Board sleep clock
      - description: GPLL0 DISP DIV clock from GCC
      - description: Byte clock from DSI PHY0
      - description: Pixel clock from DSI PHY0
      - description: Byte clock from DSI PHY1
      - description: Pixel clock from DSI PHY1

required:
  - compatible
  - clocks
  - '#power-domain-cells'

allOf:
  - $ref: qcom,gcc.yaml#

unevaluatedProperties: false

examples:
  - |
    #include <dt-bindings/clock/qcom,rpmcc.h>
    #include <dt-bindings/clock/qcom,shikra-gcc.h>
    clock-controller@5f00000 {
      compatible = "qcom,shikra-dispcc";
      reg = <0x5f00000 0x20000>;
      clocks = <&rpmcc RPM_SMD_XO_CLK_SRC>,
               <&sleep_clk>,
               <&gcc GCC_DISP_GPLL0_DIV_CLK_SRC>,
               <&dsi0_phy 0>,
               <&dsi0_phy 1>,
               <&dsi1_phy 0>,
               <&dsi1_phy 1>;
      #clock-cells = <1>;
      #power-domain-cells = <1>;
      #reset-cells = <1>;
    };
...
```

## Documentation/devicetree/bindings/clock/qcom,shikra-gcc.yaml
```yaml
# SPDX-License-Identifier: (GPL-2.0-only OR BSD-2-Clause)
%YAML 1.2
---
$id: http://devicetree.org/schemas/clock/qcom,shikra-gcc.yaml#
$schema: http://devicetree.org/meta-schemas/core.yaml#

title: Qualcomm Global Clock & Reset Controller on Shikra

maintainers:
  - Imran Shaik <imran.shaik@oss.qualcomm.com>
  - Taniya Das <taniya.das@oss.qualcomm.com>

description: |
  Qualcomm global clock control module provides the clocks, resets and power
  domains on Shikra.

  See also: include/dt-bindings/clock/qcom,shikra-gcc.h

properties:
  compatible:
    const: qcom,shikra-gcc

  clocks:
    items:
      - description: Board XO source
      - description: Sleep clock source
      - description: EMAC0 sgmiiphy mac rclk source
      - description: EMAC0 sgmiiphy mac tclk source
      - description: EMAC1 sgmiiphy mac rclk source
      - description: EMAC1 sgmiiphy mac tclk source
      - description: PCIE Pipe clock source
      - description: USB3 phy wrapper pipe clock source

required:
  - compatible
  - clocks
  - '#power-domain-cells'

allOf:
  - $ref: qcom,gcc.yaml#

unevaluatedProperties: false

examples:
  - |
    #include <dt-bindings/clock/qcom,rpmcc.h>
    clock-controller@1400000 {
        compatible = "qcom,shikra-gcc";
        reg = <0x01400000 0x1f0000>;
        clocks = <&rpmcc RPM_SMD_XO_CLK_SRC>,
               <&sleep_clk>,
               <&emac0_sgmiiphy_rclk>,
               <&emac0_sgmiiphy_tclk>,
               <&emac1_sgmiiphy_rclk>,
               <&emac1_sgmiiphy_tclk>,
               <&pcie_pipe_clk>,
               <&usb3_phy_wrapper_gcc_usb30_pipe_clk>;
      #clock-cells = <1>;
      #reset-cells = <1>;
      #power-domain-cells = <1>;
    };

...
```
