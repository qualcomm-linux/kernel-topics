## Documentation/devicetree/bindings/remoteproc/qcom,kaanapali-soccp-pas.yaml
```yaml
# SPDX-License-Identifier: GPL-2.0 OR BSD-2-Clause
%YAML 1.2
---
$id: http://devicetree.org/schemas/remoteproc/qcom,kaanapali-soccp-pas.yaml#
$schema: http://devicetree.org/meta-schemas/core.yaml#

title: Qualcomm Kaanapali SoCCP Peripheral Authentication Service

maintainers:
  - Jingyi Wang <jingyi.wang@oss.qualcomm.com>

description:
  The SoC Control Processor (SoCCP) is small RISC-V MCU that controls USB
  Type-C, battery charging and various other functions on Qualcomm SoCs, somewhat
  analogous to traditional PC Embedded Controllers. This document describes
  the Peripheral Authentication Service loads and boots firmware for SoCCP.

properties:
  compatible:
    enum:
      - qcom,kaanapali-soccp-pas

  reg:
    maxItems: 1

  interrupts:
    items:
      - description: Watchdog interrupt
      - description: Fatal interrupt
      - description: Ready interrupt
      - description: Handover interrupt
      - description: Stop acknowledge interrupt
      - description: Pong interrupt
      - description: Wake acknowledge interrupt

  interrupt-names:
    items:
      - const: wdog
      - const: fatal
      - const: ready
      - const: handover
      - const: stop-ack
      - const: pong
      - const: wake-ack

  clocks:
    items:
      - description: XO clock

  clock-names:
    items:
      - const: xo

  power-domains:
    items:
      - description: CX power domain
      - description: MX power domain

  power-domain-names:
    items:
      - const: cx
      - const: mx

  firmware-name:
    $ref: /schemas/types.yaml#/definitions/string-array
    items:
      - description: Firmware name of the Hexagon core
      - description: Firmware name of the Hexagon Devicetree

  memory-region:
    items:
      - description: Memory region for main Firmware authentication
      - description: Memory region for Devicetree Firmware authentication

  qcom,smem-states:
    $ref: /schemas/types.yaml#/definitions/phandle-array
    description: States used by the AP to signal the Hexagon core
    items:
      - description: Stop the remoteproc
      - description: wakeup the remoteproc
      - description: make remoteproc sleep
      - description: ping the remoteproc

  qcom,smem-state-names:
    description: The names of the state bits used for SMP2P output
    items:
      - const: stop
      - const: wakeup
      - const: sleep
      - const: ping

  glink-edge:
    $ref: /schemas/remoteproc/qcom,glink-edge.yaml#
    unevaluatedProperties: false
    description: |
      Qualcomm G-Link subnode which represents communication edge, channels
      and devices related to the Remoteproc.

required:
  - compatible
  - reg
  - memory-region
  - clocks
  - clock-names
  - interrupts
  - interrupt-names
  - qcom,smem-states
  - qcom,smem-state-names

unevaluatedProperties: false

examples:
  - |
    #include <dt-bindings/clock/qcom,rpmh.h>
    #include <dt-bindings/interrupt-controller/arm-gic.h>
    #include <dt-bindings/interrupt-controller/irq.h>
    #include <dt-bindings/mailbox/qcom-ipcc.h>
    #include <dt-bindings/power/qcom-rpmpd.h>

    remoteproc@d00000 {
        compatible = "qcom,kaanapali-soccp-pas";
        reg = <0x00d00000 0x200000>;

        clocks = <&rpmhcc RPMH_CXO_CLK>;
        clock-names = "xo";

        interrupts-extended = <&intc GIC_SPI 167 IRQ_TYPE_EDGE_RISING>,
                              <&soccp_smp2p_in 0 IRQ_TYPE_EDGE_RISING>,
                              <&soccp_smp2p_in 1 IRQ_TYPE_EDGE_RISING>,
                              <&soccp_smp2p_in 2 IRQ_TYPE_EDGE_RISING>,
                              <&soccp_smp2p_in 3 IRQ_TYPE_EDGE_RISING>,
                              <&soccp_smp2p_in 9 IRQ_TYPE_EDGE_RISING>,
                              <&soccp_smp2p_in 10 IRQ_TYPE_EDGE_RISING>;
        interrupt-names = "wdog",
                          "fatal",
                          "ready",
                          "handover",
                          "stop-ack",
                          "pong",
                          "wake-ack";

        memory-region = <&soccp_mem>,
                        <&soccp_dtb_mem_mem>;

        firmware-name = "qcom/kaanapali/soccp.mbn",
                        "qcom/kaanapali/soccp_dtb.mbn";

        power-domains = <&rpmhpd RPMHPD_CX>,
                        <&rpmhpd RPMHPD_MX>;
        power-domain-names = "cx",
                             "mx";

        qcom,smem-states = <&soccp_smp2p_out 0>,
                           <&soccp_smp2p_out 10>,
                           <&soccp_smp2p_out 9>,
                           <&soccp_smp2p_out 8>;
        qcom,smem-state-names = "stop",
                                "wakeup",
                                "sleep",
                                "ping";

        glink-edge {
            interrupts-extended = <&ipcc IPCC_MPROC_SOCCP
                                         IPCC_MPROC_SIGNAL_GLINK_QMP
                                         IRQ_TYPE_EDGE_RISING>;
            mboxes = <&ipcc IPCC_MPROC_SOCCP
                            IPCC_MPROC_SIGNAL_GLINK_QMP>;

            label = "soccp";
            qcom,remote-pid = <19>;

            /* ... */
        };
    };
```

## Documentation/devicetree/bindings/soc/qcom/qcom,eud.yaml
```yaml
# SPDX-License-Identifier: (GPL-2.0 OR BSD-2-Clause)
%YAML 1.2
---
$id: http://devicetree.org/schemas/soc/qcom/qcom,eud.yaml#
$schema: http://devicetree.org/meta-schemas/core.yaml#

title: Qualcomm Embedded USB Debugger

maintainers:
  - Souradeep Chowdhury <quic_schowdhu@quicinc.com>

description:
  This binding describes the Qualcomm Embedded USB Debugger (EUD), an on-chip
  mini USB hub that enables USB-based debug capabilities. The EUD block is
  positioned between the High-Speed USB PHY and the USB controller, where it
  intercepts the UTMI interface to support debug and bypass modes. EUD can be
  supported on up to two High-Speed USB ports.

properties:
  compatible:
    items:
      - enum:
          - qcom,sc7280-eud
      - const: qcom,eud

  reg:
    items:
      - description: EUD Base Register Region
      - description: EUD Mode Manager Register

  interrupts:
    description: EUD interrupt
    maxItems: 1

  '#address-cells':
    const: 1

  '#size-cells':
    const: 0

patternProperties:
  "^eud-path@[0-1]$":
    type: object
    description:
      Represents one High-Speed UTMI path that EUD intercepts. This node models
      the physical data path intercepted by EUD and provides graph endpoints to
      link the USB controller and the external connector associated with this path.

    properties:
      reg:
        maxItems: 1
        description: Path number

      phys:
        maxItems: 1
        description: High-Speed USB PHY associated with this data path.

      usb-role-switch:
        type: boolean
        description:
          Set this property if the USB port on this path is role switch capable.
          In device role, debug mode inserts the EUD hub into the UTMI path. In
          host role, the EUD hub is bypassed and UTMI traffic flows directly
          between the PHY and the USB controller.

      ports:
        $ref: /schemas/graph.yaml#/properties/ports
        description:
          These ports are to be attached to the endpoint of the USB controller node
          and USB connector node.

        properties:
          port@0:
            $ref: /schemas/graph.yaml#/properties/port
            description: This port is to be attached to the USB controller.

          port@1:
            $ref: /schemas/graph.yaml#/properties/port
            description: This port is to be attached to the USB connector.

    required:
      - reg
      - phys
      - ports

    additionalProperties: false

required:
  - compatible
  - reg

additionalProperties: false

examples:
  - |
    eud@88e0000 {
        compatible = "qcom,sc7280-eud", "qcom,eud";
        reg = <0x88e0000 0x2000>,
              <0x88e2000 0x1000>;
        #address-cells = <1>;
        #size-cells = <0>;

        eud-path@0 {
            reg = <0>;
            phys = <&usb_1_hsphy>;
            usb-role-switch;

            ports {
                #address-cells = <1>;
                #size-cells = <0>;

                port@0 {
                    reg = <0>;
                    eud_ep: endpoint {
                        remote-endpoint = <&usb2_role_switch>;
                    };
                };

                port@1 {
                    reg = <1>;
                    eud_con: endpoint {
                        remote-endpoint = <&con_eud>;
                    };
                };
            };
        };
    };
```

## Documentation/devicetree/bindings/sound/qcom,q6apm-lpass-dais.yaml
```yaml
# SPDX-License-Identifier: GPL-2.0 OR BSD-2-Clause
%YAML 1.2
---
$id: http://devicetree.org/schemas/sound/qcom,q6apm-lpass-dais.yaml#
$schema: http://devicetree.org/meta-schemas/core.yaml#

title: Qualcomm DSP LPASS (Low Power Audio SubSystem) Audio Ports

maintainers:
  - Krzysztof Kozlowski <krzk@kernel.org>
  - Srinivas Kandagatla <srinivas.kandagatla@linaro.org>

allOf:
  - $ref: dai-common.yaml#

properties:
  compatible:
    enum:
      - qcom,q6apm-lpass-dais

  '#sound-dai-cells':
    const: 1

  '#address-cells':
    const: 1

  '#size-cells':
    const: 0

# Digital Audio Interfaces
patternProperties:
  '^dai@[0-9]+$':
    type: object
    description:
      Q6DSP Digital Audio Interfaces.

    properties:
      reg:
        description:
          Digital Audio Interface ID

      clocks:
        minItems: 1
        maxItems: 3

      clock-names:
        minItems: 1
        maxItems: 3

    additionalProperties: false

required:
  - compatible
  - '#sound-dai-cells'

unevaluatedProperties: false

examples:
  - |
    #include <dt-bindings/sound/qcom,q6afe.h>

    bedais {
        compatible = "qcom,q6apm-lpass-dais";
        #sound-dai-cells = <1>;
        #address-cells = <1>;
        #size-cells = <0>;

        dai@16 {
           reg = <PRIMARY_MI2S_RX>;
           clocks = <&q6prmcc LPASS_CLK_ID_MCLK_1
                              LPASS_CLK_ATTRIBUTE_COUPLE_NO>;
           clock-names = "mclk";
        };
    };
```

## drivers/pci/pwrctrl/Kconfig
```kconfig
# SPDX-License-Identifier: GPL-2.0-only

config HAVE_PWRCTL
	bool

config PCI_PWRCTL
	tristate

config PCI_PWRCTL_PWRSEQ
	tristate
	select POWER_SEQUENCING
	select PCI_PWRCTL

config PCI_PWRCTL_SLOT
	tristate "PCI Power Control driver for PCI slots"
	select PCI_PWRCTL
	help
	  Say Y here to enable the PCI Power Control driver to control the power
	  state of PCI slots.

	  This is a generic driver that controls the power state of different
	  PCI slots. The voltage regulators powering the rails of the PCI slots
	  are expected to be defined in the devicetree node of the PCI bridge.

config PCI_PWRCTRL_TC9563
	tristate "PCI Power Control driver for TC9563 PCIe switch"
	select PCI_PWRCTL
	help
	  Say Y here to enable the PCI Power Control driver of TC9563 PCIe
	  switch.

	  This driver enables power and configures the TC9563 PCIe switch
	  through i2c.
```

## drivers/ras/aest/Kconfig
```kconfig
# SPDX-License-Identifier: GPL-2.0
#
# ARM Error Source Table Support
#
# Copyright (c) 2025, Alibaba Group.
#

config AEST
	tristate "ARM AEST Driver"
	depends on ACPI_AEST && RAS

	help
	  The Arm Error Source Table (AEST) provides details on ACPI
	  extensions that enable kernel-first handling of errors in a
	  system that supports the Armv8 RAS extensions.

	  If set, the kernel will report and log hardware errors.
```
