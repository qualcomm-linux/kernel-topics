// SPDX-License-Identifier: BSD-3-Clause
/*
 * Copyright (c) Qualcomm Technologies, Inc. and/or its subsidiaries.
 */

#include <dt-bindings/interrupt-controller/irq.h>
#include <dt-bindings/spmi/spmi.h>

&spmi_bus1 {
	pmh0104_j_e1: pmic@PMH0104_J_E1_SID {
		compatible = "qcom,pmh0104", "qcom,spmi-pmic";
		reg = <PMH0104_J_E1_SID SPMI_USID>;
		#address-cells = <1>;
		#size-cells = <0>;

		pmh0104_j_e1_temp_alarm: temp-alarm@a00 {
			compatible = "qcom,spmi-temp-alarm";
			reg = <0xa00>;
			interrupts = <PMH0104_J_E1_SID 0xa 0x0 IRQ_TYPE_EDGE_BOTH>;
			#thermal-sensor-cells = <0>;
		};

		pmh0104_j_e1_gpios: gpio@8800 {
			compatible = "qcom,pmh0104-gpio", "qcom,spmi-gpio";
			reg = <0x8800>;
			gpio-controller;
			gpio-ranges = <&pmh0104_j_e1_gpios 0 0 8>;
			#gpio-cells = <2>;
			interrupt-controller;
			#interrupt-cells = <2>;
		};
	};
};
