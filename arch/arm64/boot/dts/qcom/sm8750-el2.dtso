// SPDX-License-Identifier: BSD-3-Clause
/*
 * Copyright (c) Qualcomm Technologies, Inc. and/or its subsidiaries.

 * Pakala specific modifications required to boot in EL2.
 */

/dts-v1/;
/plugin/;

&gpu_zap_shader {
	status = "disabled";
};

&remoteproc_adsp {
	iommus = <&apps_smmu 0x1000 0x0>,
		 <&apps_smmu 0x10a0 0x0>,
		 <&apps_smmu 0x00a5 0x0>,
		 <&apps_smmu 0x0425 0x0>,
		 <&apps_smmu 0x0525 0x0>,
		 <&apps_smmu 0x0125 0x0>;
};

&remoteproc_cdsp {
	iommus = <&apps_smmu 0x0c00 0x0>;
};
