// SPDX-License-Identifier: BSD-3-Clause
/*
 * Copyright (c) Qualcomm Technologies, Inc. and/or its subsidiaries.
 *
 * Shikra staging overlay - add staging-specific device tree modifications here.
 */

/dts-v1/;
/plugin/;

&soc {
	tgu@9840000 {
		compatible = "qcom,tgu", "arm,primecell";
		reg = <0x0 0x9840000 0x0 0x1000>;

		clocks = <&aoss_qmp>;
		clock-names = "apb_pclk";
	};
};

/*
 * Expand the RGMII register window of both ethernet controllers to a full
 * page. vfio-platform only marks a region mmap-able when its address and size
 * are page aligned, which the DPDK stmmac PMD needs to probe the devices.
 */
&ethernet0 {
	reg = <0x0 0x05d00000 0x0 0x10000>,
	      <0x0 0x05d16000 0x0 0x1000>;
};

&ethernet1 {
	reg = <0x0 0x05d20000 0x0 0x10000>,
	      <0x0 0x05d36000 0x0 0x1000>;
};
